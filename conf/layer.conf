## conf/layer.conf
```bitbake
# We have a conf and classes directory, add to BBPATH
BBPATH .= ":${LAYERDIR}"

# We have recipes-* directories, add to BBFILES
BBFILES += "${LAYERDIR}/recipes-*/*/*.bb \
            ${LAYERDIR}/recipes-*/*/*.bbappend"

BBFILE_COLLECTIONS += "meta-munters"
BBFILE_PATTERN_meta-munters = "^${LAYERDIR}/"
BBFILE_PRIORITY_meta-munters = "8"

LAYERSERIES_COMPAT_meta-munters = "hardknott"
LAYERDEPENDS_meta-munters = "core"

# selinux. need this?
# LAYERDEPENDS_meta-munters = "selinux"
# IMAGE_INSTALL_append = " libselinux libsemanage"

IMAGE_INSTALL_append = " aptkeys curl jq"



# attempt to use teamviewver: a list of dependencies for teamviewer (not all of them)
# IMAGE_INSTALL:append = " libxcb libxcb-render0 libxcb-dri2-0 libxcb-shape0 libxcb-present0 libxcb-randr0 libxcb-xkb1 libxcb-glx0 libxcb-sync1 libxcb-xinerama0 libxcb-dri3-0 libxcb-shm0"
# IMAGE_INSTALL:append = " xcb-util xcb-util-image xcb-util-renderutil libdbus-c++ libdrm libfontenc libxdmcp libx11 libxxf86vm libxshmfence libxfixes libice libsm glibc"
# IMAGE_INSTALL_append = " libgl1 libpng libxtst util-linux-libuuid libxcursor libxau sed libxrender libxdamage libxext libxml2 libmd libbsd libxrandr libpcre2 libxcomposite libxi"
# IMAGE_INSTALL_append = " libgcrypt libxkbcommon libsemanage libsepol gnupg"

# DISTRO_FEATURES_append = " polkit"
```
